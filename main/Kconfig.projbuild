## main/Kconfig.projbuild
```kconfig
menu "PDKPASS"
    config PDKPASS_SCREENSHOT
        bool "Enable USB screenshot debugging"
        default n
        help
            Enables the FAP_SCREENSHOT_V1 command with bounded USB output.
            Disabled in normal builds to save a task stack and USB resources.
    config PDKPASS_BATTERY_DIAGNOSTICS
        bool "Enable read-only battery diagnostics every 60 seconds"
        default n
        help
            Logs raw CW2017 SOC, cell voltage, mode and read failures over USB.
            Uses the existing I/O worker, including while the display sleeps.
            Does not change displayed SOC or write gauge/charger parameters.
            Extra sampling changes idle power; disable for battery-life tests.
endmenu
```
